/// generado por atlas_codegen.py
#include "atlas_gen.h"
#include "LCD_Functions.h"

void blit_cols(const char *p, char h, char r, char c, char x, char y) {
    // optimizar, cachos de columna en vez de pixel a pixel
    char i, j, t, b;
    for(t=0; t<r; t++) {
        for(i=0; i<c; i++) {
            for(j=0; j<8; j++) {
                b = pgm_read_byte(p+i+t*c);
                if (b & (1 << j)) {
                    setPixel (x+i, y+j+t*8);
                }
            }
        }
    }
};
const char pgm_bars[5][7] PROGMEM = {
        { 0x60, 0x00, 0x78, 0x00, 0x70, 0x00, 0x7e, }, 
        { 0x70, 0x00, 0x70, 0x00, 0x78, 0x00, 0x40, }, 
        { 0x78, 0x00, 0x60, 0x00, 0x7c, 0x00, 0x60, }, 
        { 0x7c, 0x00, 0x70, 0x00, 0x7e, 0x00, 0x40, }, 
        { 0x7c, 0x00, 0x78, 0x00, 0x40, 0x00, 0x78, }, 
    };
#define bars_len 5
void s_bars(char frame, char x, char y) {

    char h = 7, r = 1, c = 7;
    

        // frame 0
        // □ □ □ □ □ □ □
        // □ □ □ □ □ □ ■
        // □ □ □ □ □ □ ■
        // □ □ ■ □ □ □ ■
        // □ □ ■ □ ■ □ ■
        // ■ □ ■ □ ■ □ ■
        // ■ □ ■ □ ■ □ ■

        // frame 1
        // □ □ □ □ □ □ □
        // □ □ □ □ □ □ □
        // □ □ □ □ □ □ □
        // □ □ □ □ ■ □ □
        // ■ □ ■ □ ■ □ □
        // ■ □ ■ □ ■ □ □
        // ■ □ ■ □ ■ □ ■

        // frame 2
        // □ □ □ □ □ □ □
        // □ □ □ □ □ □ □
        // □ □ □ □ ■ □ □
        // ■ □ □ □ ■ □ □
        // ■ □ □ □ ■ □ □
        // ■ □ ■ □ ■ □ ■
        // ■ □ ■ □ ■ □ ■

        // frame 3
        // □ □ □ □ □ □ □
        // □ □ □ □ ■ □ □
        // ■ □ □ □ ■ □ □
        // ■ □ □ □ ■ □ □
        // ■ □ ■ □ ■ □ □
        // ■ □ ■ □ ■ □ □
        // ■ □ ■ □ ■ □ ■

        // frame 4
        // □ □ □ □ □ □ □
        // □ □ □ □ □ □ □
        // ■ □ □ □ □ □ □
        // ■ □ ■ □ □ □ ■
        // ■ □ ■ □ □ □ ■
        // ■ □ ■ □ □ □ ■
        // ■ □ ■ □ ■ □ ■

    blit_cols(pgm_bars[frame], h, r, c, x, y);

};
const char pgm_corner[4][3] PROGMEM = {
        { 0x07, 0x01, 0x01, }, 
        { 0x01, 0x01, 0x07, }, 
        { 0x04, 0x04, 0x07, }, 
        { 0x07, 0x04, 0x04, }, 
    };
#define corner_len 4
void s_corner(char frame, char x, char y) {

    char h = 3, r = 1, c = 3;
    

        // frame 0
        // ■ ■ ■
        // ■ □ □
        // ■ □ □

        // frame 1
        // ■ ■ ■
        // □ □ ■
        // □ □ ■

        // frame 2
        // □ □ ■
        // □ □ ■
        // ■ ■ ■

        // frame 3
        // ■ □ □
        // ■ □ □
        // ■ ■ ■

    blit_cols(pgm_corner[frame], h, r, c, x, y);

};
const char pgm_crankset[14][7] PROGMEM = {
        { 0x08, 0x08, 0x1c, 0x14, 0x1c, 0x08, 0x08, }, 
        { 0x0c, 0x08, 0x1c, 0x14, 0x1c, 0x08, 0x18, }, 
        { 0x02, 0x04, 0x1c, 0x14, 0x1c, 0x10, 0x20, }, 
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        { 0x18, 0x08, 0x1c, 0x14, 0x1c, 0x08, 0x0c, }, 
    };
#define crankset_len 14
void s_crankset(char frame, char x, char y) {

    char h = 7, r = 1, c = 7;
    

        // frame 0
        // □ □ □ □ □ □ □
        // □ □ □ □ □ □ □
        // □ □ ■ ■ ■ □ □
        // ■ ■ ■ □ ■ ■ ■
        // □ □ ■ ■ ■ □ □
        // □ □ □ □ □ □ □
        // □ □ □ □ □ □ □

        // frame 1
        // □ □ □ □ □ □ □
        // □ □ □ □ □ □ □
        // ■ □ ■ ■ ■ □ □
        // ■ ■ ■ □ ■ ■ ■
        // □ □ ■ ■ ■ □ ■
        // □ □ □ □ □ □ □
        // □ □ □ □ □ □ □

        // frame 2
        // □ □ □ □ □ □ □
        // ■ □ □ □ □ □ □
        // □ ■ ■ ■ ■ □ □
        // □ □ ■ □ ■ □ □
        // □ □ ■ ■ ■ ■ □
        // □ □ □ □ □ □ ■
        // □ □ □ □ □ □ □

        // frame 3
        // ■ □ □ □ □ □ □
        // ■ □ □ □ □ □ □
        // □ ■ ■ ■ ■ □ □
        // □ □ ■ □ ■ □ □
        // □ □ ■ ■ ■ ■ □
        // □ □ □ □ □ □ ■
        // □ □ □ □ □ □ ■

        // frame 4
        // ■ ■ □ □ □ □ □
        // □ □ ■ □ □ □ □
        // □ □ ■ ■ ■ □ □
        // □ □ ■ □ ■ □ □
        // □ □ ■ ■ ■ □ □
        // □ □ □ □ ■ □ □
        // □ □ □ □ □ ■ ■

        // frame 5
        // □ ■ □ □ □ □ □
        // □ □ ■ □ □ □ □
        // □ □ ■ ■ ■ □ □
        // □ □ ■ □ ■ □ □
        // □ □ ■ ■ ■ □ □
        // □ □ □ □ ■ □ □
        // □ □ □ □ □ ■ □

        // frame 6
        // □ □ ■ ■ □ □ □
        // □ □ □ ■ □ □ □
        // □ □ ■ ■ ■ □ □
        // □ □ ■ □ ■ □ □
        // □ □ ■ ■ ■ □ □
        // □ □ □ ■ □ □ □
        // □ □ □ ■ ■ □ □

        // frame 7
        // □ □ □ ■ □ □ □
        // □ □ □ ■ □ □ □
        // □ □ ■ ■ ■ □ □
        // □ □ ■ □ ■ □ □
        // □ □ ■ ■ ■ □ □
        // □ □ □ ■ □ □ □
        // □ □ □ ■ □ □ □

        // frame 8
        // □ □ □ ■ ■ □ □
        // □ □ □ ■ □ □ □
        // □ □ ■ ■ ■ □ □
        // □ □ ■ □ ■ □ □
        // □ □ ■ ■ ■ □ □
        // □ □ □ ■ □ □ □
        // □ □ ■ ■ □ □ □

        // frame 9
        // □ □ □ □ □ ■ □
        // □ □ □ □ ■ □ □
        // □ □ ■ ■ ■ □ □
        // □ □ ■ □ ■ □ □
        // □ □ ■ ■ ■ □ □
        // □ □ ■ □ □ □ □
        // □ ■ □ □ □ □ □

        // frame 10
        // □ □ □ □ □ ■ ■
        // □ □ □ □ ■ □ □
        // □ □ ■ ■ ■ □ □
        // □ □ ■ □ ■ □ □
        // □ □ ■ ■ ■ □ □
        // □ □ ■ □ □ □ □
        // ■ ■ □ □ □ □ □

        // frame 11
        // □ □ □ □ □ □ ■
        // □ □ □ □ □ □ ■
        // □ □ ■ ■ ■ ■ □
        // □ □ ■ □ ■ □ □
        // □ ■ ■ ■ ■ □ □
        // ■ □ □ □ □ □ □
        // ■ □ □ □ □ □ □

        // frame 12
        // □ □ □ □ □ □ □
        // □ □ □ □ □ □ ■
        // □ □ ■ ■ ■ ■ □
        // □ □ ■ □ ■ □ □
        // □ ■ ■ ■ ■ □ □
        // ■ □ □ □ □ □ □
        // □ □ □ □ □ □ □

        // frame 13
        // □ □ □ □ □ □ □
        // □ □ □ □ □ □ □
        // □ □ ■ ■ ■ □ ■
        // ■ ■ ■ □ ■ ■ ■
        // ■ □ ■ ■ ■ □ □
        // □ □ □ □ □ □ □
        // □ □ □ □ □ □ □

    blit_cols(pgm_crankset[frame], h, r, c, x, y);

};
const char pgm_font[13][5] PROGMEM = {
        { 0x1f, 0x11, 0x11, 0x11, 0x1f, }, 
        { 0x00, 0x01, 0x1f, 0x00, 0x00, }, 
        { 0x1d, 0x15, 0x15, 0x15, 0x17, }, 
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        { 0x00, 0x00, 0x00, 0x00, 0x00, }, 
    };
#define font_len 13
void s_font(char frame, char x, char y) {

    char h = 5, r = 1, c = 5;
    

        // frame 0
        // ■ ■ ■ ■ ■
        // ■ □ □ □ ■
        // ■ □ □ □ ■
        // ■ □ □ □ ■
        // ■ ■ ■ ■ ■

        // frame 1
        // □ ■ ■ □ □
        // □ □ ■ □ □
        // □ □ ■ □ □
        // □ □ ■ □ □
        // □ □ ■ □ □

        // frame 2
        // ■ ■ ■ ■ ■
        // □ □ □ □ ■
        // ■ ■ ■ ■ ■
        // ■ □ □ □ □
        // ■ ■ ■ ■ ■

        // frame 3
        // ■ ■ ■ ■ □
        // □ □ □ □ ■
        // ■ ■ ■ ■ ■
        // □ □ □ □ ■
        // ■ ■ ■ ■ ■

        // frame 4
        // ■ □ □ □ ■
        // ■ □ □ □ ■
        // ■ ■ ■ ■ ■
        // □ □ □ □ ■
        // □ □ □ □ ■

        // frame 5
        // ■ ■ ■ ■ ■
        // ■ □ □ □ □
        // ■ ■ ■ ■ ■
        // □ □ □ □ ■
        // ■ ■ ■ ■ ■

        // frame 6
        // ■ ■ ■ ■ ■
        // ■ □ □ □ □
        // ■ ■ ■ ■ ■
        // ■ □ □ □ ■
        // ■ ■ ■ ■ ■

        // frame 7
        // □ ■ ■ ■ ■
        // □ □ □ □ ■
        // □ □ □ □ ■
        // □ □ □ □ ■
        // □ □ □ □ ■

        // frame 8
        // ■ ■ ■ ■ ■
        // ■ □ □ □ ■
        // ■ ■ ■ ■ ■
        // ■ □ □ □ ■
        // ■ ■ ■ ■ ■

        // frame 9
        // ■ ■ ■ ■ ■
        // ■ □ □ □ ■
        // ■ ■ ■ ■ ■
        // □ □ □ □ ■
        // ■ ■ ■ ■ ■

        // frame 10
        // □ □ □ □ □
        // □ □ □ □ □
        // □ □ □ □ □
        // □ □ □ □ □
        // □ □ ■ □ □

        // frame 11
        // □ □ □ □ □
        // □ □ ■ □ □
        // □ □ □ □ □
        // □ □ ■ □ □
        // □ □ □ □ □

        // frame 12
        // □ □ □ □ □
        // □ □ □ □ □
        // □ □ □ □ □
        // □ □ □ □ □
        // □ □ □ □ □

    blit_cols(pgm_font[frame], h, r, c, x, y);

};
const char pgm_font_x2[13][20] PROGMEM = {
        { 0xff, 0xff, 0x03, 0x03, 0x03, 0x03, 0x03, 0x03, 0xff, 0xff, 0x03, 0x03, 0x03, 0x03, 0x03, 0x03, 0x03, 0x03, 0x03, 0x03, }, 
        { 0x00, 0x00, 0x03, 0x03, 0xff, 0xff, 0x00, 0x00, 0x00, 0x00, 0x00, 0x00, 0x00, 0x00, 0x03, 0x03, 0x00, 0x00, 0x00, 0x00, }, 
        { 0xf3, 0xf3, 0x33, 0x33, 0x33, 0x33, 0x33, 0x33, 0x3f, 0x3f, 0x03, 0x03, 0x03, 0x03, 0x03, 0x03, 0x03, 0x03, 0x03, 0x03, }, 
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        { 0x00, 0x00, 0x00, 0x00, 0x00, 0x00, 0x00, 0x00, 0x00, 0x00, 0x00, 0x00, 0x00, 0x00, 0x00, 0x00, 0x00, 0x00, 0x00, 0x00, }, 
    };
#define font_x2_len 13
void s_font_x2(char frame, char x, char y) {

    char h = 10, r = 2, c = 10;
    

        // frame 0
        // ■ ■ ■ ■ ■ ■ ■ ■ ■ ■
        // ■ ■ ■ ■ ■ ■ ■ ■ ■ ■
        // ■ ■ □ □ □ □ □ □ ■ ■
        // ■ ■ □ □ □ □ □ □ ■ ■
        // ■ ■ □ □ □ □ □ □ ■ ■
        // ■ ■ □ □ □ □ □ □ ■ ■
        // ■ ■ □ □ □ □ □ □ ■ ■
        // ■ ■ □ □ □ □ □ □ ■ ■

        // ■ ■ ■ ■ ■ ■ ■ ■ ■ ■
        // ■ ■ ■ ■ ■ ■ ■ ■ ■ ■

        // frame 1
        // □ □ ■ ■ ■ ■ □ □ □ □
        // □ □ ■ ■ ■ ■ □ □ □ □
        // □ □ □ □ ■ ■ □ □ □ □
        // □ □ □ □ ■ ■ □ □ □ □
        // □ □ □ □ ■ ■ □ □ □ □
        // □ □ □ □ ■ ■ □ □ □ □
        // □ □ □ □ ■ ■ □ □ □ □
        // □ □ □ □ ■ ■ □ □ □ □

        // □ □ □ □ ■ ■ □ □ □ □
        // □ □ □ □ ■ ■ □ □ □ □

        // frame 2
        // ■ ■ ■ ■ ■ ■ ■ ■ ■ ■
        // ■ ■ ■ ■ ■ ■ ■ ■ ■ ■
        // □ □ □ □ □ □ □ □ ■ ■
        // □ □ □ □ □ □ □ □ ■ ■
        // ■ ■ ■ ■ ■ ■ ■ ■ ■ ■
        // ■ ■ ■ ■ ■ ■ ■ ■ ■ ■
        // ■ ■ □ □ □ □ □ □ □ □
        // ■ ■ □ □ □ □ □ □ □ □

        // ■ ■ ■ ■ ■ ■ ■ ■ ■ ■
        // ■ ■ ■ ■ ■ ■ ■ ■ ■ ■

        // frame 3
        // ■ ■ ■ ■ ■ ■ ■ ■ □ □
        // ■ ■ ■ ■ ■ ■ ■ ■ □ □
        // □ □ □ □ □ □ □ □ ■ ■
        // □ □ □ □ □ □ □ □ ■ ■
        // ■ ■ ■ ■ ■ ■ ■ ■ ■ ■
        // ■ ■ ■ ■ ■ ■ ■ ■ ■ ■
        // □ □ □ □ □ □ □ □ ■ ■
        // □ □ □ □ □ □ □ □ ■ ■

        // ■ ■ ■ ■ ■ ■ ■ ■ ■ ■
        // ■ ■ ■ ■ ■ ■ ■ ■ ■ ■

        // frame 4
        // ■ ■ □ □ □ □ □ □ ■ ■
        // ■ ■ □ □ □ □ □ □ ■ ■
        // ■ ■ □ □ □ □ □ □ ■ ■
        // ■ ■ □ □ □ □ □ □ ■ ■
        // ■ ■ ■ ■ ■ ■ ■ ■ ■ ■
        // ■ ■ ■ ■ ■ ■ ■ ■ ■ ■
        // □ □ □ □ □ □ □ □ ■ ■
        // □ □ □ □ □ □ □ □ ■ ■

        // □ □ □ □ □ □ □ □ ■ ■
        // □ □ □ □ □ □ □ □ ■ ■

        // frame 5
        // ■ ■ ■ ■ ■ ■ ■ ■ ■ ■
        // ■ ■ ■ ■ ■ ■ ■ ■ ■ ■
        // ■ ■ □ □ □ □ □ □ □ □
        // ■ ■ □ □ □ □ □ □ □ □
        // ■ ■ ■ ■ ■ ■ ■ ■ ■ ■
        // ■ ■ ■ ■ ■ ■ ■ ■ ■ ■
        // □ □ □ □ □ □ □ □ ■ ■
        // □ □ □ □ □ □ □ □ ■ ■

        // ■ ■ ■ ■ ■ ■ ■ ■ ■ ■
        // ■ ■ ■ ■ ■ ■ ■ ■ ■ ■

        // frame 6
        // ■ ■ ■ ■ ■ ■ ■ ■ ■ ■
        // ■ ■ ■ ■ ■ ■ ■ ■ ■ ■
        // ■ ■ □ □ □ □ □ □ □ □
        // ■ ■ □ □ □ □ □ □ □ □
        // ■ ■ ■ ■ ■ ■ ■ ■ ■ ■
        // ■ ■ ■ ■ ■ ■ ■ ■ ■ ■
        // ■ ■ □ □ □ □ □ □ ■ ■
        // ■ ■ □ □ □ □ □ □ ■ ■

        // ■ ■ ■ ■ ■ ■ ■ ■ ■ ■
        // ■ ■ ■ ■ ■ ■ ■ ■ ■ ■

        // frame 7
        // □ □ ■ ■ ■ ■ ■ ■ ■ ■
        // □ □ ■ ■ ■ ■ ■ ■ ■ ■
        // □ □ □ □ □ □ □ □ ■ ■
        // □ □ □ □ □ □ □ □ ■ ■
        // □ □ □ □ □ □ □ □ ■ ■
        // □ □ □ □ □ □ □ □ ■ ■
        // □ □ □ □ □ □ □ □ ■ ■
        // □ □ □ □ □ □ □ □ ■ ■

        // □ □ □ □ □ □ □ □ ■ ■
        // □ □ □ □ □ □ □ □ ■ ■

        // frame 8
        // ■ ■ ■ ■ ■ ■ ■ ■ ■ ■
        // ■ ■ ■ ■ ■ ■ ■ ■ ■ ■
        // ■ ■ □ □ □ □ □ □ ■ ■
        // ■ ■ □ □ □ □ □ □ ■ ■
        // ■ ■ ■ ■ ■ ■ ■ ■ ■ ■
        // ■ ■ ■ ■ ■ ■ ■ ■ ■ ■
        // ■ ■ □ □ □ □ □ □ ■ ■
        // ■ ■ □ □ □ □ □ □ ■ ■

        // ■ ■ ■ ■ ■ ■ ■ ■ ■ ■
        // ■ ■ ■ ■ ■ ■ ■ ■ ■ ■

        // frame 9
        // ■ ■ ■ ■ ■ ■ ■ ■ ■ ■
        // ■ ■ ■ ■ ■ ■ ■ ■ ■ ■
        // ■ ■ □ □ □ □ □ □ ■ ■
        // ■ ■ □ □ □ □ □ □ ■ ■
        // ■ ■ ■ ■ ■ ■ ■ ■ ■ ■
        // ■ ■ ■ ■ ■ ■ ■ ■ ■ ■
        // □ □ □ □ □ □ □ □ ■ ■
        // □ □ □ □ □ □ □ □ ■ ■

        // ■ ■ ■ ■ ■ ■ ■ ■ ■ ■
        // ■ ■ ■ ■ ■ ■ ■ ■ ■ ■

        // frame 10
        // □ □ □ □ □ □ □ □ □ □
        // □ □ □ □ □ □ □ □ □ □
        // □ □ □ □ □ □ □ □ □ □
        // □ □ □ □ □ □ □ □ □ □
        // □ □ □ □ □ □ □ □ □ □
        // □ □ □ □ □ □ □ □ □ □
        // □ □ □ □ □ □ □ □ □ □
        // □ □ □ □ □ □ □ □ □ □

        // □ □ □ □ ■ ■ □ □ □ □
        // □ □ □ □ ■ ■ □ □ □ □

        // frame 11
        // □ □ □ □ □ □ □ □ □ □
        // □ □ □ □ □ □ □ □ □ □
        // □ □ □ □ ■ ■ □ □ □ □
        // □ □ □ □ ■ ■ □ □ □ □
        // □ □ □ □ □ □ □ □ □ □
        // □ □ □ □ □ □ □ □ □ □
        // □ □ □ □ ■ ■ □ □ □ □
        // □ □ □ □ ■ ■ □ □ □ □

        // □ □ □ □ □ □ □ □ □ □
        // □ □ □ □ □ □ □ □ □ □

        // frame 12
        // □ □ □ □ □ □ □ □ □ □
        // □ □ □ □ □ □ □ □ □ □
        // □ □ □ □ □ □ □ □ □ □
        // □ □ □ □ □ □ □ □ □ □
        // □ □ □ □ □ □ □ □ □ □
        // □ □ □ □ □ □ □ □ □ □
        // □ □ □ □ □ □ □ □ □ □
        // □ □ □ □ □ □ □ □ □ □

        // □ □ □ □ □ □ □ □ □ □
        // □ □ □ □ □ □ □ □ □ □

    blit_cols(pgm_font_x2[frame], h, r, c, x, y);

};
const char pgm_font_x3[13][30] PROGMEM = {
        { 0xff, 0xff, 0xff, 0x07, 0x07, 0x07, 0x07, 0x07, 0x07, 0x07, 0x07, 0x07, 0xff, 0xff, 0xff, 0x7f, 0x7f, 0x7f, 0x70, 0x70, 0x70, 0x70, 0x70, 0x70, 0x70, 0x70, 0x70, 0x7f, 0x7f, 0x7f, }, 
        { 0x00, 0x00, 0x00, 0x07, 0x07, 0x07, 0xff, 0xff, 0xff, 0x00, 0x00, 0x00, 0x00, 0x00, 0x00, 0x00, 0x00, 0x00, 0x00, 0x00, 0x00, 0x7f, 0x7f, 0x7f, 0x00, 0x00, 0x00, 0x00, 0x00, 0x00, }, 
        { 0xc7, 0xc7, 0xc7, 0xc7, 0xc7, 0xc7, 0xc7, 0xc7, 0xc7, 0xc7, 0xc7, 0xc7, 0xff, 0xff, 0xff, 0x7f, 0x7f, 0x7f, 0x71, 0x71, 0x71, 0x71, 0x71, 0x71, 0x71, 0x71, 0x71, 0x71, 0x71, 0x71, }, 
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        { 0x00, 0x00, 0x00, 0x00, 0x00, 0x00, 0x00, 0x00, 0x00, 0x00, 0x00, 0x00, 0x00, 0x00, 0x00, 0x00, 0x00, 0x00, 0x00, 0x00, 0x00, 0x00, 0x00, 0x00, 0x00, 0x00, 0x00, 0x00, 0x00, 0x00, }, 
    };
#define font_x3_len 13
void s_font_x3(char frame, char x, char y) {

    char h = 15, r = 2, c = 15;
    

        // frame 0
        // ■ ■ ■ ■ ■ ■ ■ ■ ■ ■ ■ ■ ■ ■ ■
        // ■ ■ ■ ■ ■ ■ ■ ■ ■ ■ ■ ■ ■ ■ ■
        // ■ ■ ■ ■ ■ ■ ■ ■ ■ ■ ■ ■ ■ ■ ■
        // ■ ■ ■ □ □ □ □ □ □ □ □ □ ■ ■ ■
        // ■ ■ ■ □ □ □ □ □ □ □ □ □ ■ ■ ■
        // ■ ■ ■ □ □ □ □ □ □ □ □ □ ■ ■ ■
        // ■ ■ ■ □ □ □ □ □ □ □ □ □ ■ ■ ■
        // ■ ■ ■ □ □ □ □ □ □ □ □ □ ■ ■ ■

        // ■ ■ ■ □ □ □ □ □ □ □ □ □ ■ ■ ■
        // ■ ■ ■ □ □ □ □ □ □ □ □ □ ■ ■ ■
        // ■ ■ ■ □ □ □ □ □ □ □ □ □ ■ ■ ■
        // ■ ■ ■ □ □ □ □ □ □ □ □ □ ■ ■ ■
        // ■ ■ ■ ■ ■ ■ ■ ■ ■ ■ ■ ■ ■ ■ ■
        // ■ ■ ■ ■ ■ ■ ■ ■ ■ ■ ■ ■ ■ ■ ■
        // ■ ■ ■ ■ ■ ■ ■ ■ ■ ■ ■ ■ ■ ■ ■

        // frame 1
        // □ □ □ ■ ■ ■ ■ ■ ■ □ □ □ □ □ □
        // □ □ □ ■ ■ ■ ■ ■ ■ □ □ □ □ □ □
        // □ □ □ ■ ■ ■ ■ ■ ■ □ □ □ □ □ □
        // □ □ □ □ □ □ ■ ■ ■ □ □ □ □ □ □
        // □ □ □ □ □ □ ■ ■ ■ □ □ □ □ □ □
        // □ □ □ □ □ □ ■ ■ ■ □ □ □ □ □ □
        // □ □ □ □ □ □ ■ ■ ■ □ □ □ □ □ □
        // □ □ □ □ □ □ ■ ■ ■ □ □ □ □ □ □

        // □ □ □ □ □ □ ■ ■ ■ □ □ □ □ □ □
        // □ □ □ □ □ □ ■ ■ ■ □ □ □ □ □ □
        // □ □ □ □ □ □ ■ ■ ■ □ □ □ □ □ □
        // □ □ □ □ □ □ ■ ■ ■ □ □ □ □ □ □
        // □ □ □ □ □ □ ■ ■ ■ □ □ □ □ □ □
        // □ □ □ □ □ □ ■ ■ ■ □ □ □ □ □ □
        // □ □ □ □ □ □ ■ ■ ■ □ □ □ □ □ □

        // frame 2
        // ■ ■ ■ ■ ■ ■ ■ ■ ■ ■ ■ ■ ■ ■ ■
        // ■ ■ ■ ■ ■ ■ ■ ■ ■ ■ ■ ■ ■ ■ ■
        // ■ ■ ■ ■ ■ ■ ■ ■ ■ ■ ■ ■ ■ ■ ■
        // □ □ □ □ □ □ □ □ □ □ □ □ ■ ■ ■
        // □ □ □ □ □ □ □ □ □ □ □ □ ■ ■ ■
        // □ □ □ □ □ □ □ □ □ □ □ □ ■ ■ ■
        // ■ ■ ■ ■ ■ ■ ■ ■ ■ ■ ■ ■ ■ ■ ■
        // ■ ■ ■ ■ ■ ■ ■ ■ ■ ■ ■ ■ ■ ■ ■

        // ■ ■ ■ ■ ■ ■ ■ ■ ■ ■ ■ ■ ■ ■ ■
        // ■ ■ ■ □ □ □ □ □ □ □ □ □ □ □ □
        // ■ ■ ■ □ □ □ □ □ □ □ □ □ □ □ □
        // ■ ■ ■ □ □ □ □ □ □ □ □ □ □ □ □
        // ■ ■ ■ ■ ■ ■ ■ ■ ■ ■ ■ ■ ■ ■ ■
        // ■ ■ ■ ■ ■ ■ ■ ■ ■ ■ ■ ■ ■ ■ ■
        // ■ ■ ■ ■ ■ ■ ■ ■ ■ ■ ■ ■ ■ ■ ■

        // frame 3
        // ■ ■ ■ ■ ■ ■ ■ ■ ■ ■ ■ ■ □ □ □
        // ■ ■ ■ ■ ■ ■ ■ ■ ■ ■ ■ ■ □ □ □
        // ■ ■ ■ ■ ■ ■ ■ ■ ■ ■ ■ ■ □ □ □
        // □ □ □ □ □ □ □ □ □ □ □ □ ■ ■ ■
        // □ □ □ □ □ □ □ □ □ □ □ □ ■ ■ ■
        // □ □ □ □ □ □ □ □ □ □ □ □ ■ ■ ■
        // ■ ■ ■ ■ ■ ■ ■ ■ ■ ■ ■ ■ ■ ■ ■
        // ■ ■ ■ ■ ■ ■ ■ ■ ■ ■ ■ ■ ■ ■ ■

        // ■ ■ ■ ■ ■ ■ ■ ■ ■ ■ ■ ■ ■ ■ ■
        // □ □ □ □ □ □ □ □ □ □ □ □ ■ ■ ■
        // □ □ □ □ □ □ □ □ □ □ □ □ ■ ■ ■
        // □ □ □ □ □ □ □ □ □ □ □ □ ■ ■ ■
        // ■ ■ ■ ■ ■ ■ ■ ■ ■ ■ ■ ■ ■ ■ ■
        // ■ ■ ■ ■ ■ ■ ■ ■ ■ ■ ■ ■ ■ ■ ■
        // ■ ■ ■ ■ ■ ■ ■ ■ ■ ■ ■ ■ ■ ■ ■

        // frame 4
        // ■ ■ ■ □ □ □ □ □ □ □ □ □ ■ ■ ■
        // ■ ■ ■ □ □ □ □ □ □ □ □ □ ■ ■ ■
        // ■ ■ ■ □ □ □ □ □ □ □ □ □ ■ ■ ■
        // ■ ■ ■ □ □ □ □ □ □ □ □ □ ■ ■ ■
        // ■ ■ ■ □ □ □ □ □ □ □ □ □ ■ ■ ■
        // ■ ■ ■ □ □ □ □ □ □ □ □ □ ■ ■ ■
        // ■ ■ ■ ■ ■ ■ ■ ■ ■ ■ ■ ■ ■ ■ ■
        // ■ ■ ■ ■ ■ ■ ■ ■ ■ ■ ■ ■ ■ ■ ■

        // ■ ■ ■ ■ ■ ■ ■ ■ ■ ■ ■ ■ ■ ■ ■
        // □ □ □ □ □ □ □ □ □ □ □ □ ■ ■ ■
        // □ □ □ □ □ □ □ □ □ □ □ □ ■ ■ ■
        // □ □ □ □ □ □ □ □ □ □ □ □ ■ ■ ■
        // □ □ □ □ □ □ □ □ □ □ □ □ ■ ■ ■
        // □ □ □ □ □ □ □ □ □ □ □ □ ■ ■ ■
        // □ □ □ □ □ □ □ □ □ □ □ □ ■ ■ ■

        // frame 5
        // ■ ■ ■ ■ ■ ■ ■ ■ ■ ■ ■ ■ ■ ■ ■
        // ■ ■ ■ ■ ■ ■ ■ ■ ■ ■ ■ ■ ■ ■ ■
        // ■ ■ ■ ■ ■ ■ ■ ■ ■ ■ ■ ■ ■ ■ ■
        // ■ ■ ■ □ □ □ □ □ □ □ □ □ □ □ □
        // ■ ■ ■ □ □ □ □ □ □ □ □ □ □ □ □
        // ■ ■ ■ □ □ □ □ □ □ □ □ □ □ □ □
        // ■ ■ ■ ■ ■ ■ ■ ■ ■ ■ ■ ■ ■ ■ ■
        // ■ ■ ■ ■ ■ ■ ■ ■ ■ ■ ■ ■ ■ ■ ■

        // ■ ■ ■ ■ ■ ■ ■ ■ ■ ■ ■ ■ ■ ■ ■
        // □ □ □ □ □ □ □ □ □ □ □ □ ■ ■ ■
        // □ □ □ □ □ □ □ □ □ □ □ □ ■ ■ ■
        // □ □ □ □ □ □ □ □ □ □ □ □ ■ ■ ■
        // ■ ■ ■ ■ ■ ■ ■ ■ ■ ■ ■ ■ ■ ■ ■
        // ■ ■ ■ ■ ■ ■ ■ ■ ■ ■ ■ ■ ■ ■ ■
        // ■ ■ ■ ■ ■ ■ ■ ■ ■ ■ ■ ■ ■ ■ ■

        // frame 6
        // ■ ■ ■ ■ ■ ■ ■ ■ ■ ■ ■ ■ ■ ■ ■
        // ■ ■ ■ ■ ■ ■ ■ ■ ■ ■ ■ ■ ■ ■ ■
        // ■ ■ ■ ■ ■ ■ ■ ■ ■ ■ ■ ■ ■ ■ ■
        // ■ ■ ■ □ □ □ □ □ □ □ □ □ □ □ □
        // ■ ■ ■ □ □ □ □ □ □ □ □ □ □ □ □
        // ■ ■ ■ □ □ □ □ □ □ □ □ □ □ □ □
        // ■ ■ ■ ■ ■ ■ ■ ■ ■ ■ ■ ■ ■ ■ ■
        // ■ ■ ■ ■ ■ ■ ■ ■ ■ ■ ■ ■ ■ ■ ■

        // ■ ■ ■ ■ ■ ■ ■ ■ ■ ■ ■ ■ ■ ■ ■
        // ■ ■ ■ □ □ □ □ □ □ □ □ □ ■ ■ ■
        // ■ ■ ■ □ □ □ □ □ □ □ □ □ ■ ■ ■
        // ■ ■ ■ □ □ □ □ □ □ □ □ □ ■ ■ ■
        // ■ ■ ■ ■ ■ ■ ■ ■ ■ ■ ■ ■ ■ ■ ■
        // ■ ■ ■ ■ ■ ■ ■ ■ ■ ■ ■ ■ ■ ■ ■
        // ■ ■ ■ ■ ■ ■ ■ ■ ■ ■ ■ ■ ■ ■ ■

        // frame 7
        // □ □ □ ■ ■ ■ ■ ■ ■ ■ ■ ■ ■ ■ ■
        // □ □ □ ■ ■ ■ ■ ■ ■ ■ ■ ■ ■ ■ ■
        // □ □ □ ■ ■ ■ ■ ■ ■ ■ ■ ■ ■ ■ ■
        // □ □ □ □ □ □ □ □ □ □ □ □ ■ ■ ■
        // □ □ □ □ □ □ □ □ □ □ □ □ ■ ■ ■
        // □ □ □ □ □ □ □ □ □ □ □ □ ■ ■ ■
        // □ □ □ □ □ □ □ □ □ □ □ □ ■ ■ ■
        // □ □ □ □ □ □ □ □ □ □ □ □ ■ ■ ■

        // □ □ □ □ □ □ □ □ □ □ □ □ ■ ■ ■
        // □ □ □ □ □ □ □ □ □ □ □ □ ■ ■ ■
        // □ □ □ □ □ □ □ □ □ □ □ □ ■ ■ ■
        // □ □ □ □ □ □ □ □ □ □ □ □ ■ ■ ■
        // □ □ □ □ □ □ □ □ □ □ □ □ ■ ■ ■
        // □ □ □ □ □ □ □ □ □ □ □ □ ■ ■ ■
        // □ □ □ □ □ □ □ □ □ □ □ □ ■ ■ ■

        // frame 8
        // ■ ■ ■ ■ ■ ■ ■ ■ ■ ■ ■ ■ ■ ■ ■
        // ■ ■ ■ ■ ■ ■ ■ ■ ■ ■ ■ ■ ■ ■ ■
        // ■ ■ ■ ■ ■ ■ ■ ■ ■ ■ ■ ■ ■ ■ ■
        // ■ ■ ■ □ □ □ □ □ □ □ □ □ ■ ■ ■
        // ■ ■ ■ □ □ □ □ □ □ □ □ □ ■ ■ ■
        // ■ ■ ■ □ □ □ □ □ □ □ □ □ ■ ■ ■
        // ■ ■ ■ ■ ■ ■ ■ ■ ■ ■ ■ ■ ■ ■ ■
        // ■ ■ ■ ■ ■ ■ ■ ■ ■ ■ ■ ■ ■ ■ ■

        // ■ ■ ■ ■ ■ ■ ■ ■ ■ ■ ■ ■ ■ ■ ■
        // ■ ■ ■ □ □ □ □ □ □ □ □ □ ■ ■ ■
        // ■ ■ ■ □ □ □ □ □ □ □ □ □ ■ ■ ■
        // ■ ■ ■ □ □ □ □ □ □ □ □ □ ■ ■ ■
        // ■ ■ ■ ■ ■ ■ ■ ■ ■ ■ ■ ■ ■ ■ ■
        // ■ ■ ■ ■ ■ ■ ■ ■ ■ ■ ■ ■ ■ ■ ■
        // ■ ■ ■ ■ ■ ■ ■ ■ ■ ■ ■ ■ ■ ■ ■

        // frame 9
        // ■ ■ ■ ■ ■ ■ ■ ■ ■ ■ ■ ■ ■ ■ ■
        // ■ ■ ■ ■ ■ ■ ■ ■ ■ ■ ■ ■ ■ ■ ■
        // ■ ■ ■ ■ ■ ■ ■ ■ ■ ■ ■ ■ ■ ■ ■
        // ■ ■ ■ □ □ □ □ □ □ □ □ □ ■ ■ ■
        // ■ ■ ■ □ □ □ □ □ □ □ □ □ ■ ■ ■
        // ■ ■ ■ □ □ □ □ □ □ □ □ □ ■ ■ ■
        // ■ ■ ■ ■ ■ ■ ■ ■ ■ ■ ■ ■ ■ ■ ■
        // ■ ■ ■ ■ ■ ■ ■ ■ ■ ■ ■ ■ ■ ■ ■

        // ■ ■ ■ ■ ■ ■ ■ ■ ■ ■ ■ ■ ■ ■ ■
        // □ □ □ □ □ □ □ □ □ □ □ □ ■ ■ ■
        // □ □ □ □ □ □ □ □ □ □ □ □ ■ ■ ■
        // □ □ □ □ □ □ □ □ □ □ □ □ ■ ■ ■
        // ■ ■ ■ ■ ■ ■ ■ ■ ■ ■ ■ ■ ■ ■ ■
        // ■ ■ ■ ■ ■ ■ ■ ■ ■ ■ ■ ■ ■ ■ ■
        // ■ ■ ■ ■ ■ ■ ■ ■ ■ ■ ■ ■ ■ ■ ■

        // frame 10
        // □ □ □ □ □ □ □ □ □ □ □ □ □ □ □
        // □ □ □ □ □ □ □ □ □ □ □ □ □ □ □
        // □ □ □ □ □ □ □ □ □ □ □ □ □ □ □
        // □ □ □ □ □ □ □ □ □ □ □ □ □ □ □
        // □ □ □ □ □ □ □ □ □ □ □ □ □ □ □
        // □ □ □ □ □ □ □ □ □ □ □ □ □ □ □
        // □ □ □ □ □ □ □ □ □ □ □ □ □ □ □
        // □ □ □ □ □ □ □ □ □ □ □ □ □ □ □

        // □ □ □ □ □ □ □ □ □ □ □ □ □ □ □
        // □ □ □ □ □ □ □ □ □ □ □ □ □ □ □
        // □ □ □ □ □ □ □ □ □ □ □ □ □ □ □
        // □ □ □ □ □ □ □ □ □ □ □ □ □ □ □
        // □ □ □ □ □ □ ■ ■ ■ □ □ □ □ □ □
        // □ □ □ □ □ □ ■ ■ ■ □ □ □ □ □ □
        // □ □ □ □ □ □ ■ ■ ■ □ □ □ □ □ □

        // frame 11
        // □ □ □ □ □ □ □ □ □ □ □ □ □ □ □
        // □ □ □ □ □ □ □ □ □ □ □ □ □ □ □
        // □ □ □ □ □ □ □ □ □ □ □ □ □ □ □
        // □ □ □ □ □ □ ■ ■ ■ □ □ □ □ □ □
        // □ □ □ □ □ □ ■ ■ ■ □ □ □ □ □ □
        // □ □ □ □ □ □ ■ ■ ■ □ □ □ □ □ □
        // □ □ □ □ □ □ □ □ □ □ □ □ □ □ □
        // □ □ □ □ □ □ □ □ □ □ □ □ □ □ □

        // □ □ □ □ □ □ □ □ □ □ □ □ □ □ □
        // □ □ □ □ □ □ ■ ■ ■ □ □ □ □ □ □
        // □ □ □ □ □ □ ■ ■ ■ □ □ □ □ □ □
        // □ □ □ □ □ □ ■ ■ ■ □ □ □ □ □ □
        // □ □ □ □ □ □ □ □ □ □ □ □ □ □ □
        // □ □ □ □ □ □ □ □ □ □ □ □ □ □ □
        // □ □ □ □ □ □ □ □ □ □ □ □ □ □ □

        // frame 12
        // □ □ □ □ □ □ □ □ □ □ □ □ □ □ □
        // □ □ □ □ □ □ □ □ □ □ □ □ □ □ □
        // □ □ □ □ □ □ □ □ □ □ □ □ □ □ □
        // □ □ □ □ □ □ □ □ □ □ □ □ □ □ □
        // □ □ □ □ □ □ □ □ □ □ □ □ □ □ □
        // □ □ □ □ □ □ □ □ □ □ □ □ □ □ □
        // □ □ □ □ □ □ □ □ □ □ □ □ □ □ □
        // □ □ □ □ □ □ □ □ □ □ □ □ □ □ □

        // □ □ □ □ □ □ □ □ □ □ □ □ □ □ □
        // □ □ □ □ □ □ □ □ □ □ □ □ □ □ □
        // □ □ □ □ □ □ □ □ □ □ □ □ □ □ □
        // □ □ □ □ □ □ □ □ □ □ □ □ □ □ □
        // □ □ □ □ □ □ □ □ □ □ □ □ □ □ □
        // □ □ □ □ □ □ □ □ □ □ □ □ □ □ □
        // □ □ □ □ □ □ □ □ □ □ □ □ □ □ □

    blit_cols(pgm_font_x3[frame], h, r, c, x, y);

};
const char pgm_road[4][7] PROGMEM = {
        { 0x00, 0x7f, 0x00, 0x77, 0x00, 0x7f, 0x00, }, 
        { 0x00, 0x7f, 0x00, 0x6e, 0x00, 0x7f, 0x00, }, 
        { 0x00, 0x7f, 0x00, 0x5d, 0x00, 0x7f, 0x00, }, 
        { 0x00, 0x7f, 0x00, 0x3b, 0x00, 0x7f, 0x00, }, 
    };
#define road_len 4
void s_road(char frame, char x, char y) {

    char h = 7, r = 1, c = 7;
    

        // frame 0
        // □ ■ □ ■ □ ■ □
        // □ ■ □ ■ □ ■ □
        // □ ■ □ ■ □ ■ □
        // □ ■ □ □ □ ■ □
        // □ ■ □ ■ □ ■ □
        // □ ■ □ ■ □ ■ □
        // □ ■ □ ■ □ ■ □

        // frame 1
        // □ ■ □ □ □ ■ □
        // □ ■ □ ■ □ ■ □
        // □ ■ □ ■ □ ■ □
        // □ ■ □ ■ □ ■ □
        // □ ■ □ □ □ ■ □
        // □ ■ □ ■ □ ■ □
        // □ ■ □ ■ □ ■ □

        // frame 2
        // □ ■ □ ■ □ ■ □
        // □ ■ □ □ □ ■ □
        // □ ■ □ ■ □ ■ □
        // □ ■ □ ■ □ ■ □
        // □ ■ □ ■ □ ■ □
        // □ ■ □ □ □ ■ □
        // □ ■ □ ■ □ ■ □

        // frame 3
        // □ ■ □ ■ □ ■ □
        // □ ■ □ ■ □ ■ □
        // □ ■ □ □ □ ■ □
        // □ ■ □ ■ □ ■ □
        // □ ■ □ ■ □ ■ □
        // □ ■ □ ■ □ ■ □
        // □ ■ □ □ □ ■ □

    blit_cols(pgm_road[frame], h, r, c, x, y);

};
const char pgm_sandclock[4][7] PROGMEM = {
        { 0x41, 0x23, 0x17, 0x0f, 0x17, 0x23, 0x41, }, 
        { 0x41, 0x22, 0x16, 0x1e, 0x16, 0x22, 0x41, }, 
        { 0x41, 0x22, 0x34, 0x3c, 0x34, 0x22, 0x41, }, 
        { 0x41, 0x62, 0x74, 0x78, 0x74, 0x62, 0x41, }, 
    };
#define sandclock_len 4
void s_sandclock(char frame, char x, char y) {

    char h = 7, r = 1, c = 7;
    

        // frame 0
        // ■ ■ ■ ■ ■ ■ ■
        // □ ■ ■ ■ ■ ■ □
        // □ □ ■ ■ ■ □ □
        // □ □ □ ■ □ □ □
        // □ □ ■ □ ■ □ □
        // □ ■ □ □ □ ■ □
        // ■ □ □ □ □ □ ■

        // frame 1
        // ■ □ □ □ □ □ ■
        // □ ■ ■ ■ ■ ■ □
        // □ □ ■ ■ ■ □ □
        // □ □ □ ■ □ □ □
        // □ □ ■ ■ ■ □ □
        // □ ■ □ □ □ ■ □
        // ■ □ □ □ □ □ ■

        // frame 2
        // ■ □ □ □ □ □ ■
        // □ ■ □ □ □ ■ □
        // □ □ ■ ■ ■ □ □
        // □ □ □ ■ □ □ □
        // □ □ ■ ■ ■ □ □
        // □ ■ ■ ■ ■ ■ □
        // ■ □ □ □ □ □ ■

        // frame 3
        // ■ □ □ □ □ □ ■
        // □ ■ □ □ □ ■ □
        // □ □ ■ □ ■ □ □
        // □ □ □ ■ □ □ □
        // □ □ ■ ■ ■ □ □
        // □ ■ ■ ■ ■ ■ □
        // ■ ■ ■ ■ ■ ■ ■

    blit_cols(pgm_sandclock[frame], h, r, c, x, y);

};
const char pgm_speedometer[7][54] PROGMEM = {
        { 0x00, 0x40, 0x40, 0x00, 0x08, 0x10, 0x00, 0x02, 0x04, 0x00, 0x00, 0x00, 0x00,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 0x02, }, 
        { 0x00, 0x40, 0x40, 0x00, 0x08, 0x50, 0x40, 0x82, 0x84, 0x80, 0x00, 0x00, 0x00,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 0x02, }, 
        { 0x00, 0x40, 0x40, 0x00, 0x08, 0x10, 0x00, 0x02, 0x04, 0x00, 0x18, 0x60, 0x80,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 0x02, }, 
        { 0x00, 0x40, 0x40, 0x00, 0x08, 0x10, 0x00, 0x02, 0x04, 0x00, 0x00, 0x00, 0x00,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 0x02, }, 
        { 0x00, 0x40, 0x40, 0x00, 0x08, 0x10, 0x00, 0x02, 0x04, 0x00, 0x00, 0x00, 0x00,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 0x02, }, 
        { 0x00, 0x40, 0x40, 0x00, 0x08, 0x10, 0x00, 0x02, 0x04, 0x00, 0x00, 0x00, 0x00,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 0x02, }, 
        { 0x00, 0x40, 0x40, 0x00, 0x08, 0x10, 0x00, 0x02, 0x04, 0x00, 0x00, 0x00, 0x00,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 0x02, }, 
    };
#define speedometer_len 7
void s_speedometer(char frame, char x, char y) {

    char h = 10, r = 2, c = 27;
    

        // frame 0
        // □ □ □ □ □ □ □ □ □ □ □ □ □ ■ □ □ □ □ □ □ □ □ □ □ □ □ □
        // □ □ □ □ □ □ □ ■ □ □ □ □ □ ■ □ □ □ □ □ ■ □ □ □ □ □ □ □
        // □ □ □ □ □ □ □ □ ■ □ □ □ □ □ □ □ □ □ ■ □ □ □ □ □ □ □ □
        // □ □ □ □ ■ □ □ □ □ □ □ □ □ □ □ □ □ □ □ □ □ □ ■ □ □ □ □
        // □ □ □ □ □ ■ □ □ □ □ □ □ □ □ □ □ □ □ □ □ □ ■ □ □ □ □ □
        // □ □ □ □ □ □ □ □ □ □ □ □ □ □ □ □ □ □ □ □ □ □ □ □ □ □ □
        // □ ■ ■ □ □ □ □ □ □ □ □ □ □ □ □ □ □ □ □ □ □ □ □ □ ■ ■ □
        // □ □ □ □ □ □ □ □ □ □ □ □ □ □ □ □ □ □ □ □ □ □ □ □ □ □ □

        // □ □ □ □ ■ ■ ■ ■ ■ □ □ □ ■ ■ ■ □ □ □ □ □ □ □ □ □ □ □ □
        // ■ ■ □ □ □ □ □ □ □ ■ ■ ■ ■ □ ■ □ □ □ □ □ □ □ □ □ □ ■ ■

        // frame 1
        // □ □ □ □ □ □ □ □ □ □ □ □ □ ■ □ □ □ □ □ □ □ □ □ □ □ □ □
        // □ □ □ □ □ □ □ ■ □ □ □ □ □ ■ □ □ □ □ □ ■ □ □ □ □ □ □ □
        // □ □ □ □ □ □ □ □ ■ □ □ □ □ □ □ □ □ □ ■ □ □ □ □ □ □ □ □
        // □ □ □ □ ■ □ □ □ □ □ □ □ □ □ □ □ □ □ □ □ □ □ ■ □ □ □ □
        // □ □ □ □ □ ■ □ □ □ □ □ □ □ □ □ □ □ □ □ □ □ ■ □ □ □ □ □
        // □ □ □ □ □ □ □ □ □ □ □ □ □ □ □ □ □ □ □ □ □ □ □ □ □ □ □
        // □ ■ ■ □ □ ■ ■ □ □ □ □ □ □ □ □ □ □ □ □ □ □ □ □ □ ■ ■ □
        // □ □ □ □ □ □ □ ■ ■ ■ □ □ □ □ □ □ □ □ □ □ □ □ □ □ □ □ □

        // □ □ □ □ □ □ □ □ □ □ ■ ■ ■ ■ ■ □ □ □ □ □ □ □ □ □ □ □ □
        // ■ ■ □ □ □ □ □ □ □ □ □ □ ■ □ ■ □ □ □ □ □ □ □ □ □ □ ■ ■

        // frame 2
        // □ □ □ □ □ □ □ □ □ □ □ □ □ ■ □ □ □ □ □ □ □ □ □ □ □ □ □
        // □ □ □ □ □ □ □ ■ □ □ □ □ □ ■ □ □ □ □ □ ■ □ □ □ □ □ □ □
        // □ □ □ □ □ □ □ □ ■ □ □ □ □ □ □ □ □ □ ■ □ □ □ □ □ □ □ □
        // □ □ □ □ ■ □ □ □ □ □ ■ □ □ □ □ □ □ □ □ □ □ □ ■ □ □ □ □
        // □ □ □ □ □ ■ □ □ □ □ ■ □ □ □ □ □ □ □ □ □ □ ■ □ □ □ □ □
        // □ □ □ □ □ □ □ □ □ □ □ ■ □ □ □ □ □ □ □ □ □ □ □ □ □ □ □
        // □ ■ ■ □ □ □ □ □ □ □ □ ■ □ □ □ □ □ □ □ □ □ □ □ □ ■ ■ □
        // □ □ □ □ □ □ □ □ □ □ □ □ ■ □ □ □ □ □ □ □ □ □ □ □ □ □ □

        // □ □ □ □ □ □ □ □ □ □ □ □ ■ ■ ■ □ □ □ □ □ □ □ □ □ □ □ □
        // ■ ■ □ □ □ □ □ □ □ □ □ □ ■ □ ■ □ □ □ □ □ □ □ □ □ □ ■ ■

        // frame 3
        // □ □ □ □ □ □ □ □ □ □ □ □ □ ■ □ □ □ □ □ □ □ □ □ □ □ □ □
        // □ □ □ □ □ □ □ ■ □ □ □ □ □ ■ □ □ □ □ □ ■ □ □ □ □ □ □ □
        // □ □ □ □ □ □ □ □ ■ □ □ □ □ □ □ □ □ □ ■ □ □ □ □ □ □ □ □
        // □ □ □ □ ■ □ □ □ □ □ □ □ □ □ □ □ □ □ □ □ □ □ ■ □ □ □ □
        // □ □ □ □ □ ■ □ □ □ □ □ □ □ ■ □ □ □ □ □ □ □ ■ □ □ □ □ □
        // □ □ □ □ □ □ □ □ □ □ □ □ □ ■ □ □ □ □ □ □ □ □ □ □ □ □ □
        // □ ■ ■ □ □ □ □ □ □ □ □ □ □ ■ □ □ □ □ □ □ □ □ □ □ ■ ■ □
        // □ □ □ □ □ □ □ □ □ □ □ □ □ ■ □ □ □ □ □ □ □ □ □ □ □ □ □

        // □ □ □ □ □ □ □ □ □ □ □ □ ■ ■ ■ □ □ □ □ □ □ □ □ □ □ □ □
        // ■ ■ □ □ □ □ □ □ □ □ □ □ ■ □ ■ □ □ □ □ □ □ □ □ □ □ ■ ■

        // frame 4
        // □ □ □ □ □ □ □ □ □ □ □ □ □ ■ □ □ □ □ □ □ □ □ □ □ □ □ □
        // □ □ □ □ □ □ □ ■ □ □ □ □ □ ■ □ □ □ □ □ ■ □ □ □ □ □ □ □
        // □ □ □ □ □ □ □ □ ■ □ □ □ □ □ □ □ □ □ ■ □ □ □ □ □ □ □ □
        // □ □ □ □ ■ □ □ □ □ □ □ □ □ □ □ □ ■ □ □ □ □ □ ■ □ □ □ □
        // □ □ □ □ □ ■ □ □ □ □ □ □ □ □ □ □ ■ □ □ □ □ ■ □ □ □ □ □
        // □ □ □ □ □ □ □ □ □ □ □ □ □ □ □ ■ □ □ □ □ □ □ □ □ □ □ □
        // □ ■ ■ □ □ □ □ □ □ □ □ □ □ □ □ ■ □ □ □ □ □ □ □ □ ■ ■ □
        // □ □ □ □ □ □ □ □ □ □ □ □ □ □ ■ □ □ □ □ □ □ □ □ □ □ □ □

        // □ □ □ □ □ □ □ □ □ □ □ □ ■ ■ ■ □ □ □ □ □ □ □ □ □ □ □ □
        // ■ ■ □ □ □ □ □ □ □ □ □ □ ■ □ ■ □ □ □ □ □ □ □ □ □ □ ■ ■

        // frame 5
        // □ □ □ □ □ □ □ □ □ □ □ □ □ ■ □ □ □ □ □ □ □ □ □ □ □ □ □
        // □ □ □ □ □ □ □ ■ □ □ □ □ □ ■ □ □ □ □ □ ■ □ □ □ □ □ □ □
        // □ □ □ □ □ □ □ □ ■ □ □ □ □ □ □ □ □ □ ■ □ □ □ □ □ □ □ □
        // □ □ □ □ ■ □ □ □ □ □ □ □ □ □ □ □ □ □ □ □ □ □ ■ □ □ □ □
        // □ □ □ □ □ ■ □ □ □ □ □ □ □ □ □ □ □ □ □ □ □ ■ □ □ □ □ □
        // □ □ □ □ □ □ □ □ □ □ □ □ □ □ □ □ □ □ □ □ □ □ □ □ □ □ □
        // □ ■ ■ □ □ □ □ □ □ □ □ □ □ □ □ □ □ □ □ □ ■ ■ □ □ ■ ■ □
        // □ □ □ □ □ □ □ □ □ □ □ □ □ □ □ □ □ ■ ■ ■ □ □ □ □ □ □ □

        // □ □ □ □ □ □ □ □ □ □ □ □ ■ ■ ■ ■ ■ □ □ □ □ □ □ □ □ □ □
        // ■ ■ □ □ □ □ □ □ □ □ □ □ ■ □ ■ □ □ □ □ □ □ □ □ □ □ ■ ■

        // frame 6
        // □ □ □ □ □ □ □ □ □ □ □ □ □ ■ □ □ □ □ □ □ □ □ □ □ □ □ □
        // □ □ □ □ □ □ □ ■ □ □ □ □ □ ■ □ □ □ □ □ ■ □ □ □ □ □ □ □
        // □ □ □ □ □ □ □ □ ■ □ □ □ □ □ □ □ □ □ ■ □ □ □ □ □ □ □ □
        // □ □ □ □ ■ □ □ □ □ □ □ □ □ □ □ □ □ □ □ □ □ □ ■ □ □ □ □
        // □ □ □ □ □ ■ □ □ □ □ □ □ □ □ □ □ □ □ □ □ □ ■ □ □ □ □ □
        // □ □ □ □ □ □ □ □ □ □ □ □ □ □ □ □ □ □ □ □ □ □ □ □ □ □ □
        // □ ■ ■ □ □ □ □ □ □ □ □ □ □ □ □ □ □ □ □ □ □ □ □ □ ■ ■ □
        // □ □ □ □ □ □ □ □ □ □ □ □ □ □ □ □ □ □ □ □ □ □ □ □ □ □ □

        // □ □ □ □ □ □ □ □ □ □ □ □ ■ ■ ■ □ □ □ ■ ■ ■ ■ ■ □ □ □ □
        // ■ ■ □ □ □ □ □ □ □ □ □ □ ■ □ ■ ■ ■ ■ □ □ □ □ □ □ □ ■ ■

    blit_cols(pgm_speedometer[frame], h, r, c, x, y);

};
